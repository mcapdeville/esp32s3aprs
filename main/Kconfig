## main/Kconfig
```kconfig
menu "ESP32s3APRSr"
		config ESP32S3APRS_FORCE_ON_GPIO
		int "Force on Pin"
		default 46

		config ESP32S3APRS_LIGHT_SLEEP
		bool "Enable light sleep"
		default y

	menu "spiffs"
		config ESP32S3APRS_SPIFFS_MOUNT_POINT
		string "Mount point for spiffs filesystem"
		default "/spiffs"

		config ESP32S3APRS_SPIFFS_PART_LABEL
		string "Partition label for spiffs filesystem"
		default "spiffs"

		config ESP32S3APRS_SPIFFS_MAX_FILES
		int "Maximum number of files"
		default 4
	endmenu

	menu "Console"
		config ESP32S3APRS_CONSOLE_BAUD_RATE
		int "Console baud rate"
		default 115200

		config ESP32S3APRS_CONSOLE_TX_GPIO
		int "Console Tx pin"
		default 1

		config ESP32S3APRS_CONSOLE_RX_GPIO
		int "Console Rx pin"
		default 3
	endmenu

	menu "Adc2"
		config ESP32S3APRS_ADC2_BATTERY_GPIO
		int "Battery measurment adc2 input pin"
		default 11

		config ESP32S3APRS_ADC2_CH1_GPIO
		int "Measurment input adc2 channel 1 pin"
		default 15

		config ESP32S3APRS_ADC2_CH2_GPIO
		int "Measurment input adc2 channel 2 pin"
		default 16

		config ESP32S3APRS_ADC2_CH3_GPIO
		int "Measurment input adc2 channel 3 pin"
		default 17

		config ESP32S3APRS_ADC2_CH4_GPIO
		int "Measurment input adc2 channel 4 pin"
		default 18
	endmenu

	menu "Buttons"
		config ESP32S3APRS_BUTTON_RIGHT_GPIO
		int "Right button pin"
		default 2

		config ESP32S3APRS_BUTTON_CENTER_GPIO
		int "Center button pin"
		default 13

		config ESP32S3APRS_BUTTON_LEFT_GPIO
		int "LEFT button pin"
		default 12

	endmenu

	menu "Spi"
		config ESP32S3APRS_SPI_HOST
		int "SPI host bcontroler"
		default 2

		config ESP32S3APRS_SPI_D_GPIO
		int "Serial half-duplex data pin or MOSI pin"
		default 35

		config ESP32S3APRS_SPI_Q_GPIO
		int "MISO pin for full duplex transfer"
		default -1

		config ESP32S3APRS_SPI_CLK_GPIO
		int "Serial clock pin"
		default 36

		config ESP32S3APRS_SPI_MAX_TRANSFER_SIZE
		int "Maximum transfer size"
		default 6512
	endmenu

	menu "Epd display"
		config ESP32S3APRS_EPD_CS_GPIO
		int "Chip select pin"
		default 10

		config ESP32S3APRS_EPD_DC_GPIO
		int "Data/Command pin"
		default 9

		config ESP32S3APRS_EPD_BUSY_GPIO
		int "Busy pin"
		default 38

		config ESP32S3APRS_EPD_X_DEF
		int "Horizontal definition"
		default 122

		config ESP32S3APRS_EPD_Y_DEF
		int "Vertical definition"
		default 250

		config ESP32S3APRS_EPD_RESOLUTION
		int "Resolution of display screen"
		default 130
	endmenu

	menu "Radio"
		config ESP32S3APRS_RADIO_SAMPLE_RATE
		int "Radio ADC/DAC sample rate"
		default 52800

		config ESP32S3APRS_RADIO_FRAME_LEN
		int "Radio ADC/DAC frame len"
		default 53

		config ESP32S3APRS_RADIO_UART_NUM
		int "Uart controler"
		default 2

		config ESP32S3APRS_RADIO_TX_GPIO
		int "Uart TX pin"
		default 42

		config ESP32S3APRS_RADIO_RX_GPIO
		int "Uart RX pin"
		default 41

		config ESP32S3APRS_RADIO_ADC_GPIO
		int "ADC pin"
		default 8

		config ESP32S3APRS_RADIO_DAC_GPIO
		int "DAC pin"
		default 40

		config ESP32S3APRS_RADIO_SQ_GPIO
		int "Squelch pin"
		default 3

		config ESP32S3APRS_RADIO_HL_GPIO
		int "Hi/Low pin"
		default	48

		config ESP32S3APRS_RADIO_PD_GPIO
		int "Powerdown pin"
		default 45

		config ESP32S3APRS_RADIO_PTT_GPIO
		int "PTT pin"
		default 37
	endmenu

	menu "Gps"
		config ESP32S3APRS_GPS_UART_NUM
		int "Uart controler"
		default 1

		config ESP32S3APRS_GPS_BAUD_RATE
		int "Uart baud rate"
		default 9600

		config ESP32S3APRS_GPS_TX_GPIO
		int "Tx pin"
		default 47

		config ESP32S3APRS_GPS_RX_GPIO
		int "Rx pin"
		default 21

		config ESP32S3APRS_GPS_RESET_GPIO
		int "Reset pin"
		default 39

		config ESP32S3APRS_GPS_1PPS_GPIO
		int "1 PPS pin"
		default 14
	endmenu

	menu "Aprs"
		config ESP32S3APRS_APRS_DEFAULT_CALLID
		string "Default callid"
		default "CALLID-0"
		
		config ESP32S3APRS_APRS_DEFAULT_PATH
		string "Default relay path"
		default "WIDE1-1,WIDE2-2"
	endmenu

endmenu
```

## micropython/Kconfig
```kconfig
# SPDX-License-Identifier: MIT
#
# The MIT License (MIT)
#
# Copyright (c) 2013-2016 Damien P. George
#
# Permission is hereby granted, free of charge, to any person obtaining a copy
# of this software and associated documentation files (the "Software"), to deal
# in the Software without restriction, including without limitation the rights
# to use, copy, modify, merge, publish, distribute, sublicense, and/or sell
# copies of the Software, and to permit persons to whom the Software is
# furnished to do so, subject to the following conditions:
#
# The above copyright notice and this permission notice shall be included in
# all copies or substantial portions of the Software.
#
# THE SOFTWARE IS PROVIDED "AS IS", WITHOUT WARRANTY OF ANY KIND, EXPRESS OR
# IMPLIED, INCLUDING BUT NOT LIMITED TO THE WARRANTIES OF MERCHANTABILITY,
# FITNESS FOR A PARTICULAR PURPOSE AND NONINFRINGEMENT. IN NO EVENT SHALL THE
# AUTHORS OR COPYRIGHT HOLDERS BE LIABLE FOR ANY CLAIM, DAMAGES OR OTHER
# LIABILITY, WHETHER IN AN ACTION OF CONTRACT, TORT OR OTHERWISE, ARISING FROM,
# OUT OF OR IN CONNECTION WITH THE SOFTWARE OR THE USE OR OTHER DEALINGS IN
# THE SOFTWARE.
#

menu "micropython"

    choice MICROPY_ROM_LEVEL
        prompt "Microtyhon rom level features"
        default MICROPY_ROM_LEVEL_EXTRA
                help
                This option sets MICROPY_CONFIG_ROM_LEVEL options 
        config MICROPY_ROM_LEVEL_MINIMUM
            bool "Minimum features"
        config MICROPY_ROM_LEVEL_CORE
            bool "Core features"
            select MICROPY_COMPILER
            select MICROPY_SYS
        config MICROPY_ROM_LEVEL_BASIC
            bool "Basic features"
            select MICROPY_COMPILER
            select MICROPY_SYS
        config MICROPY_ROM_LEVEL_EXTRA
            bool "Extra feature"
            select MICROPY_COMPILER
            select MICROPY_SYS
            select MICROPY_HELPER_REPL
        config MICROPY_ROM_LEVEL_FULL
            bool "Full feature"
        config MICROPY_ROM_LEVEL_EVERYTHINGS
            bool "Compile everythings"
    endchoice

    config MICROPY_USER_BOARD
	bool "include board files"
	default n

    config MICROPY_USER_BOARD_DIR
	string "Base user board directory"
	depends on MICROPY_USER_BOARD
	default "${PROJECT_DIR}/main"

    config MICROPY_FROZEN_MANIFEST
        string "Path to the frozzen manifest file"
        default "${MICROPY_PORT_DIR}/boards/manifest.py"

    config MICROPY_HW_BOARD_NAME
        string "Name of the hardware board"
        default "ESP board"

    config MICROPY_HW_MCU_NAME
        string "Name of the hardware cpu"
        default IDF_TARGET

    config MICROPY_PERSISTENT_CODE_LOAD
	bool "Support for native code loading"
	default n

    config MICROPY_EMIT_NATIVE_CODE
	bool "Compiler emit native code"
	default n
	depends on !IDF_TARGET_ESP32C3

    config MICROPY_THREAD
	bool "Enable Thread support"
	default n
    
    config MICROPY_BUILTINS_BYTEARRAY
        bool "Include bytearray support"
        default n

    config MICROPY_BUILTIN_INIT
	bool "Initialize newly loaded builtin module"
	depends on MICROPY_EXTERNAL_MODULE
	default n

    config MICROPY_EXTERNAL_MODULE
        bool "Support external modules"
        default n

    config MICROPY_MODULE_FROZEN
        bool "Support frozen modules"
	depends on MICROPY_EXTERNAL_MODULE
        default n
    
    config MICROPY_WEAK_LINKS
	bool "Support Weak links"
	depends on MICROPY_EXTERNAL_MODULE
	default n

    config MICROPY_VFS
        bool "Include VFS support"
        default n
        select MICROPY_BUILTINS_BYTEARRAY

        config MICROPY_VFS_POSIX
            bool "Include POSIX VFS support"
            depends on MICROPY_VFS

        config MICROPY_VFS_FAT
            bool "Include FAT support"
            depends on MICROPY_VFS

        config MICROPY_VFS_LFS1
            bool "Include LFS1 support"
            depends on MICROPY_VFS
    
        config MICROPY_VFS_LFS2
            bool "Include LFS2 support"
            depends on MICROPY_VFS

    config MICROPY_PY_VFS
	    bool "Include vfs module"
        depends on MICROPY_VFS
		default y

    config MICROPY_HELPER_REPL
	bool "Include REPL"
	default n
	select MICROPY_COMPILER
	select MICROPY_BUILTINS_BYTEARRAY
   
        config MICROPY_REPL_EMACS_KEYS
        	bool "Repl Emacs style keys"
        	default n
        	depends on MICROPY_HELPER_REPL 

        config MICROPY_REPL_AUTO_INDENT
        	bool "Repl auto indentation"
        	default n
        	depends on MICROPY_HELPER_REPL 

    config MICROPY_COMPILER
    	bool "Include COMPILER"
       	default n
       	select MICROPY_BUILTINS_BYTEARRAY
   
    config MICROPY_SCHEDULER
	bool "Include micropy scheduler" 
	default n

    config MICROPY_MACHINE
        bool "Include umachine module"
	select MICROPY_EXTERNAL_MODULE
        default n

        config MICROPY_MACHINE_RTC
            bool "Include machine rtc"
            depends on MICROPY_MACHINE
            default n

        config MICROPY_MACHINE_SIGNAL
            bool "Include machine signal"
            depends on MICROPY_MACHINE
            default n

        config MICROPY_MACHINE_PIN
            bool "Include machine pin"
            depends on MICROPY_MACHINE
            select MICROPY_SCHEDULER
            select MICROPY_MACHINE_RTC
            default n

        config MICROPY_MACHINE_PULSE
            bool "Include machine pulse"
            depends on MICROPY_MACHINE
            default n

        config MICROPY_MACHINE_TIMER
            bool "Include machine timer"
            depends on MICROPY_MACHINE
	    select MICROPY_SCHEDULER
            default n

        config MICROPY_MACHINE_BITSTREAM	
            bool "Include machine bitstream"
            depends on MICROPY_MACHINE
	    select MICROPY_ESP32_RMT
            select MICROPY_MACHINE_PIN
            default n

        config MICROPY_MACHINE_I2C
            bool "Include machine i2c"
            depends on MICROPY_MACHINE
            select MICROPY_MACHINE_PIN
            default n

        config MICROPY_MACHINE_SOFTI2C
            bool "Include machine softi2c"
            depends on MICROPY_MACHINE
            default n

        config MICROPY_MACHINE_SPI
            bool "Include machine spi"
            depends on MICROPY_MACHINE
            select MICROPY_MACHINE_PIN
            default n

        config MICROPY_MACHINE_SOFTSPI
            bool "Include machine softspi"
            depends on MICROPY_MACHINE
            select MICROPY_MACHINE_PIN
            default n

        config MICROPY_MACHINE_I2S
            bool "Include machine i2S"
            depends on MICROPY_MACHINE
            select MICROPY_SCHEDULER
            select MICROPY_MACHINE_PIN
            default n

        config MICROPY_MACHINE_PWM
            bool "Include machine pwm"
            depends on MICROPY_MACHINE
            select MICROPY_MACHINE_PIN
            default n
	
    config MICROPY_ESP32
        bool "Include esp32 module"
	select MICROPY_EXTERNAL_MODULE
    	select MICROPY_MACHINE
    	select MICROPY_MACHINE_RTC
    	select MICROPY_MACHINE_PIN
        default n

        config MICROPY_ESP32_NVS
            bool "Support NVS in esp32"
            depends on MICROPY_ESP32
            default n

        config MICROPY_ESP32_PARTITION
            bool "Support partition in esp32"
            depends on MICROPY_ESP32
            default n

        config MICROPY_ESP32_RMT
            bool "Support RMT in esp32"
            depends on MICROPY_ESP32
            default n

        config MICROPY_ESP32_ULP
            bool "Support ULP in esp32"
            depends on MICROPY_ESP32
            depends on IDF_TARGET_ESP32
            default n

    config MICROPY_ESP
        bool "Include esp module"
	select MICROPY_EXTERNAL_MODULE
	select MICROPY_MACHINE
	select MICROPY_MACHINE_PIN
	select MICROPY_MACHINE_PULSE
        default n

    config MICROPY_GC
	bool "Include gc module"
	default n

    config MICROPY_OS
	bool "Include os module"
	default n

    config MICROPY_IO
	bool "Include io module"
	default n

    config MICROPY_SYS
	bool "Include sys module"
	default n

    config MICROPY_SYS_PATH_ARGV_DEFAULTS
	bool "set sys_path and sys_argv to defaults"
	default n
        depends on MICROPY_SYS

    config MICROPY_SYS_PATH_DEFAULT
	string "sys_path"
	default ".frozen"
        depends on MICROPY_SYS
	depends on !MICROPY_SYS_PATH_ARGV_DEFAULTS

    config MICROPY_UPLATFORM
	bool "Include uplatform module"
	default n

    config MICROPY_BTREE
	bool "Include btree module"
	default n

endmenu
```

## sdkconfig.defaults
```kconfig
CONFIG_IDF_TARGET="esp32s3"
CONFIG_PARTITION_TABLE_CUSTOM=y
CONFIG_PARTITION_TABLE_CUSTOM_FILENAME="partitions-2M.csv"
CONFIG_ADC_CONTINUOUS_ISR_IRAM_SAFE=y
CONFIG_ADC_DIGI_CLK_DIV_CALC=y
CONFIG_ADC_SARADC_TARGET_CLK=5280000
CONFIG_GPIO_CTRL_FUNC_IN_IRAM=y
CONFIG_I2S_ISR_IRAM_SAFE=y
CONFIG_I2S_FORCE_FRAC_DIVISOR=n
CONFIG_UART_ISR_IN_IRAM=y
CONFIG_LIBC_STDIN_LINE_ENDING_LF=y
CONFIG_ESP_PANIC_HANDLER_IRAM=y
CONFIG_LOG_MASTER_LEVEL=y
CONFIG_LV_COLOR_DEPTH_1=y
# CONFIG_LV_FONT_MONTSERRAT_14 is not set
CONFIG_LV_FONT_DEFAULT_MONTSERRAT_16=y
# CONFIG_LV_USE_ANIMIMG is not set
# CONFIG_LV_USE_CALENDAR is not set
# CONFIG_LV_USE_CHART is not set
# CONFIG_LV_USE_COLORWHEEL is not set
# CONFIG_LV_USE_KEYBOARD is not set
# CONFIG_LV_USE_LED is not set
# CONFIG_LV_USE_METER is not set
# CONFIG_LV_USE_MSGBOX is not set
# CONFIG_LV_USE_SPAN is not set
# CONFIG_LV_USE_SPINNER is not set
# CONFIG_LV_USE_TILEVIEW is not set
# CONFIG_LV_USE_WIN is not set
# CONFIG_LV_USE_THEME_MONO is not set
# CONFIG_LV_USE_GRID is not set
# CONFIG_LV_USE_SNAPSHOT is not set
# CONFIG_LV_BUILD_EXAMPLES is not set
CONFIG_MICROPY_VFS=y
CONFIG_MICROPY_VFS_POSIX=y
CONFIG_MICROPY_HELPER_REPL=y
CONFIG_MICROPY_REPL_AUTO_INDENT=y
CONFIG_MICROPY_BTREE=y
```
